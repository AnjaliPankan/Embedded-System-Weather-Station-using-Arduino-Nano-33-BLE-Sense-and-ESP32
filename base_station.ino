#include <Wire.h>
#include <WiFi.h>
#include <Adafruit_GFX.h>
#include <Adafruit_SSD1306.h>

#include <stdio.h>
#include <algorithm>
#include <iostream>
#include <sstream>
#include <string>
#include <vector>

#include "time.h"
#include "BLEDevice.h"


// Global definitions.

#define OLED_SCREEN_WIDTH 128 // OLED width,  in pixels
#define OLED_SCREEN_HEIGHT 64 // OLED height, in pixels

#define RED_COLOUR_MAX 255
#define RED_COLOUR_MED 100
#define RED_COLOUR_MIN 10

#define TEMP_MIN 0

#define RAIN_AREA 500
#define RAIN_MED 70
#define RAIN_MAX 100

#define WIND_MAX 15
#define WIND_MIN 0 

#define HOUR_SIX 6
#define HOUR_TWELVE 12
#define HOUR_EIGHTEEN 18
#define HOUR_TWENTYFOUR 24

// WiFi SSID and Password.
const char* ssid       = "FRITZ!Box 7530 AO";
const char* password   = "25139246479422586350";

// NTP server details for time information.
const char* ntpServer           = "pool.ntp.org";
const long  gmtOffset_sec       = 3600;
const int   daylightOffset_sec  = 3600;

// Remote station BLE service to connect to.
static BLEUUID serviceUUID("180F");
// The characteristic of the remote service.
static BLEUUID charUUID("2A19");

static boolean doConnect = false;
static boolean connected = false;
static boolean doScan = false;
static BLERemoteCharacteristic* pRemoteCharacteristic;
static BLEAdvertisedDevice* device;

// Vector to save up-to-date sensor data. 
std::vector<int> sensorData{0, 0, 0, 0, 0, 0, 0};

// Define icons for weather display.
// https://www.hackster.io/shubhamsantosh99/weather-monitoring-on-oled-c1d4a8
const unsigned char sunny [] PROGMEM = {
  0xff, 0xff, 0xff, 0xff, 0xff, 0xff, 0xff, 0x80, 0xff, 0xff, 0xff, 0xff, 0xff, 0xff, 0xff, 0x80, 
  0xff, 0xff, 0xff, 0xff, 0xff, 0xff, 0xff, 0x80, 0xff, 0xff, 0xff, 0xff, 0xff, 0xff, 0xff, 0x80, 
  0xff, 0xff, 0xff, 0xff, 0xff, 0xff, 0xff, 0x80, 0xff, 0xff, 0xff, 0xff, 0xff, 0xff, 0xff, 0x80, 
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  0xff, 0xff, 0xff, 0xff, 0xff, 0xff, 0xff, 0x80
};
const unsigned char partly_cloudy [] PROGMEM = {
  0xff, 0xff, 0xf8, 0xff, 0xff, 0xff, 0xff, 0x80, 0xff, 0xff, 0xf8, 0xff, 0xff, 0xff, 0xff, 0x80, 
  0xff, 0xff, 0xf8, 0xff, 0xff, 0xff, 0xff, 0x80, 0xff, 0xff, 0xf8, 0xff, 0xff, 0xff, 0xff, 0x80, 
  0xff, 0xff, 0xf8, 0xff, 0xff, 0xff, 0xff, 0x80, 0xff, 0xff, 0xf8, 0xff, 0xf7, 0xff, 0xff, 0x80, 
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  0xff, 0xff, 0xff, 0xff, 0xff, 0xff, 0xff, 0x80
};
const unsigned char sunny_cloudy_rain [] PROGMEM = {
  0xff, 0xff, 0xff, 0xff, 0xff, 0xff, 0xff, 0x80, 0xff, 0xff, 0xff, 0xff, 0xff, 0xff, 0xff, 0x80, 
  0xff, 0xff, 0xff, 0xef, 0xff, 0xff, 0xff, 0x80, 0xff, 0xff, 0xff, 0xe7, 0xff, 0xff, 0xff, 0x80, 
  0xff, 0xff, 0xff, 0xe7, 0xff, 0xff, 0xff, 0x80, 0xff, 0xff, 0x9f, 0xe7, 0xfb, 0xff, 0xff, 0x80, 
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  0xff, 0xff, 0xff, 0xff, 0xff, 0xff, 0xff, 0x80
};
const unsigned char cloudy [] PROGMEM = {
  0xff, 0xff, 0xff, 0xff, 0xff, 0xff, 0xff, 0xf0, 0xff, 0xff, 0xff, 0xff, 0xff, 0xff, 0xff, 0xf0,
  0xff, 0xff, 0xff, 0xff, 0xff, 0xff, 0xff, 0xf0, 0xff, 0xff, 0xff, 0xff, 0xff, 0xff, 0xff, 0xf0,
  0xff, 0xff, 0xff, 0xff, 0xff, 0xff, 0xff, 0xf0, 0xff, 0xff, 0xff, 0xfe, 0x07, 0xff, 0xff, 0xf0,
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  0xff, 0xff, 0xff, 0xff, 0xff, 0xff, 0xff, 0xf0
};
const unsigned char drizzle [] PROGMEM = {
  0xff, 0xff, 0xff, 0xff, 0xff, 0xff, 0xff, 0xe0, 0xff, 0xff, 0xff, 0xff, 0xff, 0xff, 0xff, 0xe0,
  0xff, 0xff, 0xff, 0xff, 0xff, 0xff, 0xff, 0xe0, 0xff, 0xff, 0xfc, 0x01, 0xff, 0xff, 0xff, 0xe0,
  0xff, 0xff, 0xf8, 0x00, 0x3f, 0xff, 0xff, 0xe0, 0xff, 0xff, 0xc0, 0x00, 0x07, 0xff, 0xff, 0xe0,
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  0xff, 0xff, 0xff, 0xff, 0xff, 0xff, 0xff, 0xe0
};
const unsigned char mist [] PROGMEM = {
  0xff, 0xff, 0xff, 0xff, 0xff, 0xff, 0xff, 0xe0, 0xff, 0xff, 0xff, 0xff, 0xff, 0xff, 0xff, 0xe0,
  0xff, 0xff, 0xff, 0xff, 0xff, 0xff, 0xff, 0xe0, 0xff, 0xff, 0xff, 0xff, 0xff, 0xff, 0xff, 0xe0,
  0xff, 0xff, 0xff, 0xff, 0xff, 0xff, 0xff, 0xe0, 0xff, 0xff, 0xff, 0xff, 0xff, 0xff, 0xff, 0xe0,
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  0xff, 0xff, 0xff, 0xff, 0xff, 0xff, 0xff, 0xe0, 0xff, 0xff, 0xff, 0xff, 0xff, 0xff, 0xff, 0xe0
};
const unsigned char rain [] PROGMEM = {
  0xff, 0xff, 0xff, 0xff, 0xff, 0xff, 0xff, 0xe0, 0xff, 0xff, 0xff, 0xff, 0xff, 0xff, 0xff, 0xe0,
  0xff, 0xff, 0xff, 0xc0, 0x3f, 0xff, 0xff, 0xe0, 0xff, 0xff, 0xff, 0x00, 0x0f, 0xff, 0xff, 0xe0,
  0xff, 0xff, 0xf8, 0x00, 0x01, 0xff, 0xff, 0xe0, 0xff, 0xff, 0xf0, 0x00, 0x00, 0xff, 0xff, 0xe0,
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  0xff, 0xff, 0xff, 0xff, 0xff, 0xff, 0xff, 0xe0
};
const unsigned char sleet [] PROGMEM = {
  0xff, 0xff, 0xff, 0xff, 0xff, 0xff, 0xff, 0xf0, 0xff, 0xff, 0xff, 0xff, 0xff, 0xff, 0xff, 0xf0,
  0xff, 0xff, 0xff, 0xff, 0xff, 0xff, 0xff, 0xf0, 0xff, 0xff, 0xff, 0xff, 0xff, 0xff, 0xff, 0xf0,
  0xff, 0xff, 0xff, 0xff, 0xff, 0xff, 0xff, 0xf0, 0xff, 0xff, 0xff, 0xff, 0xff, 0xff, 0xff, 0xf0,
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  0xff, 0xff, 0xff, 0xff, 0xff, 0xff, 0xff, 0xf0, 0xff, 0xff, 0xff, 0xff, 0xff, 0xff, 0xff, 0xf0
};
const unsigned char snow [] PROGMEM = {
  0xff, 0xff, 0xff, 0xf0, 0xff, 0xff, 0xff, 0x80, 0xff, 0xff, 0xff, 0xf0, 0x7f, 0xff, 0xff, 0x80,
  0xff, 0xff, 0xff, 0xe0, 0x7f, 0xff, 0xff, 0x80, 0xff, 0xff, 0xff, 0xe0, 0x3f, 0xff, 0xff, 0x80,
  0xff, 0xff, 0xff, 0xf0, 0x7f, 0xff, 0xff, 0x80, 0xff, 0xff, 0xff, 0xf0, 0x7f, 0xff, 0xff, 0x80,
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  0xff, 0xff, 0xff, 0xf0, 0xff, 0xff, 0xff, 0x80, 0xff, 0xff, 0xff, 0xf9, 0xff, 0xff, 0xff, 0x80
};

const unsigned char unknown [] PROGMEM = {
  0xff, 0xff, 0xff, 0xff, 0xff, 0xff, 0xff, 0xe0, 0xff, 0xff, 0xff, 0xff, 0xff, 0xff, 0xff, 0xe0,
  0xff, 0xff, 0xff, 0xff, 0xff, 0xff, 0xff, 0xe0, 0xff, 0xff, 0xff, 0xff, 0xff, 0xff, 0xff, 0xe0,
  0xff, 0xff, 0xff, 0xff, 0xff, 0xff, 0xff, 0xe0, 0xff, 0xff, 0xff, 0xff, 0xff, 0xff, 0xff, 0xe0,
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  0xff, 0xff, 0xff, 0xff, 0xff, 0xff, 0xff, 0xe0, 0xff, 0xff, 0xff, 0xff, 0xff, 0xff, 0xff, 0xe0
};

// Weather icon list.
//..............................................0......1..............2..................3.......4........5.....6.....7......8.....9......
const unsigned char* weather_icon [] PROGMEM = {sunny, partly_cloudy, sunny_cloudy_rain, cloudy, drizzle, mist, rain, sleet, snow, unknown};
int weather_icon_index = 9;

// Parameters for 1 hour forecast.
// RGB - 'R' last 1 hour values.
int R_array [] = {0,0,0,0,0,0,0,0,0,0,0,0,0,0,0,0,0,0,0,0,0,0,0,0,0,0,0,0,0,0,
                  0,0,0,0,0,0,0,0,0,0,0,0,0,0,0,0,0,0,0,0,0,0,0,0,0,0,0,0,0,0};
// Rain last 1 hour values. 
int r_array [] = {0,0,0,0,0,0,0,0,0,0,0,0,0,0,0,0,0,0,0,0,0,0,0,0,0,0,0,0,0,0,
                  0,0,0,0,0,0,0,0,0,0,0,0,0,0,0,0,0,0,0,0,0,0,0,0,0,0,0,0,0,0};
// Temperature last 1 hour values.                  
int T_array [] = {0,0,0,0,0,0,0,0,0,0,0,0,0,0,0,0,0,0,0,0,0,0,0,0,0,0,0,0,0,0,
                  0,0,0,0,0,0,0,0,0,0,0,0,0,0,0,0,0,0,0,0,0,0,0,0,0,0,0,0,0,0};
int forecast_array_index = -1; // array update index
int divider = 0; // divider for taking average
int R_average_value = 0;
int r_average_value = 0;
int T_average_value = 0;
long previousMillis = 0;  // last time the sensor value was updated

// Notify callback for BLE connection
static void notifyCallback(
  BLERemoteCharacteristic* pBLERemoteCharacteristic,
  uint8_t* pData,
  size_t length,
  bool isNotify) {
  // do nothing, as values are read explicitly
}

class WeatherClientCallback : public BLEClientCallbacks {
  void onConnect(BLEClient* pclient) {
  }

  void onDisconnect(BLEClient* pclient) {
    connected = false;
    Serial.println("onDisconnect");
  }
};

// BLE connect to server, code adapted from BLE client example of
// ESP32 BLE Arduino BLE_client.
bool connectToServer() {
    Serial.print("Forming a connection to remote station");
    Serial.println(device->getAddress().toString().c_str());
    
    BLEClient*  pClient  = BLEDevice::createClient();
    Serial.println(" - Created client");

    pClient->setClientCallbacks(new WeatherClientCallback());

    // Connect to the remove BLE Server.
    pClient->connect(device);
    Serial.println(" - Connected to remote station");
  
    // Obtain a reference to the weather service in the remote BLE server.
    BLERemoteService* pRemoteService = pClient->getService(serviceUUID);
    if (pRemoteService == nullptr) {
      Serial.print("Failed to find weather service UUID: ");
      Serial.println(serviceUUID.toString().c_str());
      pClient->disconnect();
      return false;
    }
    Serial.println(" - Found weather service");


    // Obtain a reference to the characteristic of weather service of the remote BLE server.
    pRemoteCharacteristic = pRemoteService->getCharacteristic(charUUID);
    if (pRemoteCharacteristic == nullptr) {
      Serial.print("Failed to find characteristic UUID: ");
      Serial.println(charUUID.toString().c_str());
      pClient->disconnect();
      return false;
    }
    Serial.println(" - Found characteristic");

    // Read the value of the characteristic.
    if(pRemoteCharacteristic->canRead()) {
      std::string value = pRemoteCharacteristic->readValue();
      Serial.print("The characteristic value was: ");
      Serial.println(value.c_str());
    }

    if(pRemoteCharacteristic->canNotify())
      pRemoteCharacteristic->registerForNotify(notifyCallback);

    connected = true;
    return true;
}

class WeatherAdvertisedDeviceCallbacks: public BLEAdvertisedDeviceCallbacks {
  void onResult(BLEAdvertisedDevice advertisedDevice) {
    Serial.print("BLE Advertised Device found: ");
    Serial.println(advertisedDevice.toString().c_str());

    if (advertisedDevice.haveServiceUUID() && advertisedDevice.isAdvertisingService(serviceUUID)) {
      BLEDevice::getScan()->stop();
      device = new BLEAdvertisedDevice(advertisedDevice);
      doConnect = true;
      doScan = true;
    }
  }
};

// Helper function to convert from string to integer vector.
std::vector<int> convertToIntArray(std::string input)
{
    std::replace(input.begin(), input.end(), ',', ' ');
    std::istringstream stringReader{ input };
    std::vector<int> result;

    int number;
    while (stringReader >> number)
    {
        result.push_back(number);
    }

    return result;
}

// Forecast weather based on sensor values.
String forecast(int T, int t, int R, int r) {
  // decide based on temperature.
  // rain case:
  if(T > TEMP_MIN) {
    if(t >= HOUR_SIX && t < HOUR_TWELVE) {    
      if(R >= RED_COLOUR_MAX){
          if(r >= RAIN_AREA) {
              weather_icon_index = 2;
              return "SUNNY with HEAVY RAIN";
          } else if(r < RAIN_AREA && r > 20) {
              weather_icon_index = 2;
              return "SUNNY with RAIN";      
          } else {
              weather_icon_index = 0;
              return "SUNNY";
          }
  
      } else if(R > RED_COLOUR_MED && R < RED_COLOUR_MAX) {
          if(r >= RAIN_AREA) {
              weather_icon_index = 2;
              return "PARTIALLY CLOUDY with HEAVY RAIN";
          } else if(r < RAIN_AREA && r > 20) {
              weather_icon_index = 2;
              return "PARTIALLY CLOUDY with RAIN";          
          } else {
              weather_icon_index = 1;
              return "PARTIALLY CLOUDY";
          }
      } else if(R > RED_COLOUR_MIN && R < RED_COLOUR_MED) {
          if(r >= RAIN_AREA) {
              weather_icon_index = 6;
              return "MOSTLY CLOUDY with HEAVY RAIN";
          } else if(r < RAIN_AREA && r > 20) {
              weather_icon_index = 6;
              return "MOSTLY CLOUDY with RAIN";          
          } else {
              weather_icon_index = 3;
              return "MOSTLY CLOUDY";
          }
      } else {
          if(r >= RAIN_AREA) {
              weather_icon_index = 6;
              return "CLOUDY with HEAVY RAIN";
          } else if(r < RAIN_AREA && r > 20) {
              weather_icon_index = 6;
              return "CLOUDY with RAIN";       
          } else {
              weather_icon_index = 3;
              return "CLOUDY";
          }
      }
    } else if(t >= HOUR_TWELVE && t < HOUR_EIGHTEEN){
      if(R >= RED_COLOUR_MAX){
          if(r >= RAIN_AREA) {
              weather_icon_index = 2;
              return "SUNNY with HEAVY RAIN";
          } else if(r < RAIN_AREA && r > 20) {
              weather_icon_index = 2;
              return "SUNNY with RAIN";         
          } else {
              weather_icon_index = 0;
              return "SUNNY"; 
          }
      } else if(R > RED_COLOUR_MED && R < RED_COLOUR_MAX) {
          if(r >= RAIN_AREA) {
              weather_icon_index = 2;
              return "PARTIALLY CLOUDY with HEAVY RAIN";
          } else if(r < RAIN_AREA && r > 20) {
              weather_icon_index = 2;
              return "PARTIALLY CLOUDY with RAIN";           
          } else {
              weather_icon_index = 1;
              return "PARTIALLY CLOUDY";
          }
      } else if(R > RED_COLOUR_MIN && R < RED_COLOUR_MED) {
          if(r >= RAIN_AREA) {
              weather_icon_index = 6;
              return "MOSTLY CLOUDY with HEAVY RAIN";
          } else if(r < RAIN_AREA && r > 20) {
              weather_icon_index = 6;
              return "MOSTLY CLOUDY with RAIN";          
          } else {
              weather_icon_index = 3;
              return "MOSTLY CLOUDY";
          }
      } else {
          if(r >= RAIN_AREA) {
              weather_icon_index = 6;
              return "CLOUDY with HEAVY RAIN";
          } else if(r < RAIN_AREA && r > 20) {
              weather_icon_index = 6;
              return "CLOUDY with RAIN";          
          } else {
              weather_icon_index = 3;
              return "CLOUDY";
          }
      }
    } else if(t >= HOUR_EIGHTEEN && t < HOUR_TWENTYFOUR){
      if(R >= RED_COLOUR_MAX){
          if(r >= RAIN_AREA) {
              weather_icon_index = 2;
              return "SUNNY with HEAVY RAIN";
          } else if(r < RAIN_AREA && r > 20) {
              weather_icon_index = 2;
              return "SUNNY with RAIN";           
          } else {
              weather_icon_index = 0;
              return "SUNNY";
          }
      } else if(R > RED_COLOUR_MED && R < RED_COLOUR_MAX) {
          if(r >= RAIN_AREA) {
              weather_icon_index = 2;
              return "PARTIALLY CLOUDY with HEAVY RAIN";
          } else if(r < RAIN_AREA && r > 20) {
              weather_icon_index = 2;
              return "PARTIALLY CLOUDY with RAIN";           
          } else {
              weather_icon_index = 1;
              return "PARTIALLY CLOUDY";
          }
      } else if(R > RED_COLOUR_MIN && R < RED_COLOUR_MED) {
          if(r >= RAIN_AREA) {
              weather_icon_index = 6;
              return "MOSTLY CLOUDY with HEAVY RAIN";
          } else if(r < RAIN_AREA && r > 20) {
              weather_icon_index = 6;
              return "MOSTLY CLOUDY with RAIN";           
          } else {
              weather_icon_index = 3;
              return "MOSTLY CLOUDY";
          }
      } else {
          if(r >= RAIN_AREA) {
              weather_icon_index = 6;
              return "CLOUDY with HEAVY RAIN";
          } else if(r < RAIN_AREA && r > 20) {
              weather_icon_index = 6;
              return "CLOUDY with RAIN";           
          } else {
              weather_icon_index = 3;
              return "CLOUDY";
          }
      }   
    } else {
      if(R >= RED_COLOUR_MAX){
          if(r >= RAIN_AREA) {
              weather_icon_index = 2;
              return "SUNNY with HEAVY RAIN";
          } else if(r < RAIN_AREA && r > 20) {
              weather_icon_index = 2;
              return "SUNNY with RAIN";        
          } else {
              weather_icon_index = 0;
              return "SUNNY";
          }
      } else if(R > RED_COLOUR_MED && R < RED_COLOUR_MAX) {
          if(r >= RAIN_AREA) {
              weather_icon_index = 2;
              return "PARTIALLY CLOUDY with HEAVY RAIN";
          } else if(r < RAIN_AREA && r > 20) {
              weather_icon_index = 2;
              return "PARTIALLY CLOUDY with RAIN";         
          } else {
              weather_icon_index = 1;
              return "PARTIALLY CLOUDY";
          }
      } else if(R > RED_COLOUR_MIN && R < RED_COLOUR_MED) {
          if(r >= RAIN_AREA) {
              weather_icon_index = 6;
              return "MOSTLY CLOUDY with HEAVY RAIN";
          } else if(r < RAIN_AREA && r > 20) {
              weather_icon_index = 6;
              return "MOSTLY CLOUDY with RAIN";           
          } else {
              weather_icon_index = 3;
              return "MOSTLY CLOUDY";
          }
      } else {
          if(r >= RAIN_AREA) {
              weather_icon_index = 6;
              return "CLOUDY with HEAVY RAIN";
          } else if(r < RAIN_AREA && r > 20) {
              weather_icon_index = 6;
              return "CLOUDY with RAIN";           
          } else {
              weather_icon_index = 3;
              return "CLOUDY";
          }
      }    
    }
  // snow case:
  } else {
    if(t >= HOUR_SIX && t < HOUR_TWELVE) {    
      if(R >= RED_COLOUR_MAX){
          if(r >= RAIN_AREA) {
              weather_icon_index = 5;
              return "SUNNY with HEAVY SNOW";
          } else if(r < RAIN_AREA && r > 20) {
              weather_icon_index = 5;
              return "SUNNY with SNOW";      
          } else {
              weather_icon_index = 0;
              return "SUNNY";
          }
  
      } else if(R > RED_COLOUR_MED && R < RED_COLOUR_MAX) {
          if(r >= RAIN_AREA) {
              weather_icon_index = 5;
              return "PARTIALLY CLOUDY with HEAVY SNOW";
          } else if(r < RAIN_AREA && r > 20) {
              weather_icon_index = 5;
              return "PARTIALLY CLOUDY with SNOW";          
          } else {
              weather_icon_index = 1;
              return "PARTIALLY CLOUDY";
          }
      } else if(R > RED_COLOUR_MIN && R < RED_COLOUR_MED) {
          if(r >= RAIN_AREA) {
              weather_icon_index = 8;
              return "MOSTLY CLOUDY with HEAVY SNOW";
          } else if(r < RAIN_AREA && r > 20) {
              weather_icon_index = 8;
              return "MOSTLY CLOUDY with SNOW";          
          } else {
              weather_icon_index = 3;
              return "MOSTLY CLOUDY";
          }
      } else {
          if(r >= RAIN_AREA) {
              weather_icon_index = 8;
              return "CLOUDY with HEAVY SNOW";
          } else if(r < RAIN_AREA && r > 20) {
              weather_icon_index = 8;
              return "CLOUDY with SNOW";       
          } else {
              weather_icon_index = 3;
              return "CLOUDY";
          }
      }
    } else if(t >= HOUR_TWELVE && t < HOUR_EIGHTEEN){
      if(R >= RED_COLOUR_MAX){
          if(r >= RAIN_AREA) {
              weather_icon_index = 5;
              return "SUNNY with HEAVY SNOW";
          } else if(r < RAIN_AREA && r > 20) {
              weather_icon_index = 5;
              return "SUNNY with SNOW";         
          } else {
              weather_icon_index = 0;
              return "SUNNY"; 
          }
      } else if(R > RED_COLOUR_MED && R < RED_COLOUR_MAX) {
          if(r >= RAIN_AREA) {
              weather_icon_index = 5;
              return "PARTIALLY CLOUDY with HEAVY SNOW";
          } else if(r < RAIN_AREA && r > 20) {
              weather_icon_index = 5;
              return "PARTIALLY CLOUDY with SNOW";           
          } else {
              weather_icon_index = 1;
              return "PARTIALLY CLOUDY";
          }
      } else if(R > RED_COLOUR_MIN && R < RED_COLOUR_MED) {
          if(r >= RAIN_AREA) {
              weather_icon_index = 8;
              return "MOSTLY CLOUDY with HEAVY SNOW";
          } else if(r < RAIN_AREA && r > 20) {
              weather_icon_index = 8;
              return "MOSTLY CLOUDY with SNOW";          
          } else {
              weather_icon_index = 3;
              return "MOSTLY CLOUDY";
          }
      } else {
          if(r >= RAIN_AREA) {
              weather_icon_index = 8;
              return "CLOUDY with HEAVY SNOW";
          } else if(r < RAIN_AREA && r > 20) {
              weather_icon_index = 8;
              return "CLOUDY with SNOW";          
          } else {
              weather_icon_index = 3;
              return "CLOUDY";
          }
      }
    } else if(t >= HOUR_EIGHTEEN && t < HOUR_TWENTYFOUR){
      if(R >= RED_COLOUR_MAX){
          if(r >= RAIN_AREA) {
              weather_icon_index = 5;
              return "SUNNY with HEAVY SNOW";
          } else if(r < RAIN_AREA && r > 20) {
              weather_icon_index = 5;
              return "SUNNY with SNOW";           
          } else {
              weather_icon_index = 0;
              return "SUNNY";
          }
      } else if(R > RED_COLOUR_MED && R < RED_COLOUR_MAX) {
          if(r >= RAIN_AREA) {
              weather_icon_index = 5;
              return "PARTIALLY CLOUDY with HEAVY SNOW";
          } else if(r < RAIN_AREA && r > 20) {
              weather_icon_index = 5;
              return "PARTIALLY CLOUDY with SNOW";           
          } else {
              weather_icon_index = 1;
              return "PARTIALLY CLOUDY";
          }
      } else if(R > RED_COLOUR_MIN && R < RED_COLOUR_MED) {
          if(r >= RAIN_AREA) {
              weather_icon_index = 8;
              return "MOSTLY CLOUDY with HEAVY SNOW";
          } else if(r < RAIN_AREA && r > 20) {
              weather_icon_index = 8;
              return "MOSTLY CLOUDY with SNOW";           
          } else {
              weather_icon_index = 3;
              return "MOSTLY CLOUDY";
          }
      } else {
          if(r >= RAIN_AREA) {
              weather_icon_index = 8;
              return "CLOUDY with HEAVY SNOW";
          } else if(r < RAIN_AREA && r > 20) {
              weather_icon_index = 8;
              return "CLOUDY with SNOW";           
          } else {
              weather_icon_index = 3;
              return "CLOUDY";
          }
      }   
    } else {
      if(R >= RED_COLOUR_MAX){
          if(r >= RAIN_AREA) {
              weather_icon_index = 5;
              return "SUNNY with HEAVY SNOW";
          } else if(r < RAIN_AREA && r > 20) {
              weather_icon_index = 5;
              return "SUNNY with SNOW";        
          } else {
              weather_icon_index = 0;
              return "SUNNY";
          }
      } else if(R > RED_COLOUR_MED && R < RED_COLOUR_MAX) {
          if(r >= RAIN_AREA) {
              weather_icon_index = 5;
              return "PARTIALLY CLOUDY with HEAVY SNOW";
          } else if(r < RAIN_AREA && r > 20) {
              weather_icon_index = 5;
              return "PARTIALLY CLOUDY with SNOW";         
          } else {
              weather_icon_index = 1;
              return "PARTIALLY CLOUDY";
          }
      } else if(R > RED_COLOUR_MIN && R < RED_COLOUR_MED) {
          if(r >= RAIN_AREA) {
              weather_icon_index = 8;
              return "MOSTLY CLOUDY with HEAVY SNOW";
          } else if(r < RAIN_AREA && r > 20) {
              weather_icon_index = 8;
              return "MOSTLY CLOUDY with SNOW";           
          } else {
              weather_icon_index = 3;
              return "MOSTLY CLOUDY";
          }
      } else {
          if(r >= RAIN_AREA) {
              weather_icon_index = 8;
              return "CLOUDY with HEAVY SNOW";
          } else if(r < RAIN_AREA && r > 20) {
              weather_icon_index = 8;
              return "CLOUDY with SNOW";           
          } else {
              weather_icon_index = 3;
              return "CLOUDY";
          }
      }    
    }
  }
}

// Update forecast arrays and parameters.
void update_forecast_values(int T, int R, int r) {
  if(divider < 60) {
    divider = divider + 1;
  }
  
  if(forecast_array_index == 59) {
    forecast_array_index = 0;
  } else {
    forecast_array_index = forecast_array_index + 1;
  }

  if(R > RED_COLOUR_MAX){
    R = RED_COLOUR_MAX + 10; // Normalize for very high R, add tolerance
  }
  R_array[forecast_array_index] = R;

  if(r > RAIN_AREA){
    r = RAIN_AREA + 10; // Normalize for very high r, add tolerance
  }
  r_array[forecast_array_index] = r;

  if(T > 30){
    T = 30; // Normalize for very high T
  }
  T_array[forecast_array_index] = T;
}

// Find R value average.
int R_average() {
  int sum = 0; 
  int average = 0;
  for(int i = 0; i < divider; i++) {
    sum = sum + R_array[i];
  }

  average = (int) (sum / divider);
  return average;
}

// Find r value average.
int r_average() {
  int sum = 0; 
  int average = 0;
  for(int i = 0; i < divider; i++) {
    sum = sum + r_array[i];
  }

  average = (int) (sum / divider);
  return average;
}

// Find T value average.
int T_average() {
  int sum = 0; 
  int average = 0;
  for(int i = 0; i < divider; i++) {
    sum = sum + T_array[i];
  }

  average = (int) (sum / divider);
  return average;
}


// The sensorData vector with index = 0 contains Read color value. 
int get_colour(){
  return sensorData[0];
}

// The sensorData vector with index = 1 contains Temperature value.
int get_temperature(){
  return sensorData[1];
}

// The sensorData vector with index = 2 contains Humidity value.
int get_humidity(){
  return sensorData[2];
}


// The sensorData vector with index = 3 contains Pressure value.
int get_pressure(){
  return sensorData[3];
}

// The sensorData vector with index = 4 contains Rain value.
int get_rain(){
  return sensorData[4];
}

// The sensorData vector with index = 5 contains wind speed value.
int get_wind(){
  return sensorData[5];
}

// The sensorData vector with index = 6 contains wind direction value.
int get_wind_direction(){
  return sensorData[6];
}

tm getLocalTime()
{
  struct tm timeinfo;
  if(!getLocalTime(&timeinfo)){
    Serial.println("Failed to obtain time");
    return tm();
  }
  Serial.println(&timeinfo, "%A, %B %d %Y %H:%M:%S");

  return timeinfo;
}

// Create an OLED display object connected to I2C.
Adafruit_SSD1306 oled(OLED_SCREEN_WIDTH, OLED_SCREEN_HEIGHT, &Wire, -1);

// Initialize base station capabilities.
void setup() {
  Serial.begin(9600);

  BLEDevice::init("");

  // Obtain a scanner and, do active scan and run for 5 seconds. 
  BLEScan* pBLEScan = BLEDevice::getScan();
  pBLEScan->setAdvertisedDeviceCallbacks(new WeatherAdvertisedDeviceCallbacks());
  pBLEScan->setWindow(449);
  pBLEScan->setInterval(1349);
  pBLEScan->setActiveScan(true);
  pBLEScan->start(5, false);
 
  // Connect to WiFi.
  Serial.printf("Connecting to %s ", ssid);
  WiFi.begin(ssid, password);
  while (WiFi.status() != WL_CONNECTED) {
      delay(500);
      Serial.print(".");
  }
  Serial.println("WIFI CONNECTED");

  // Init and get the time
  configTime(gmtOffset_sec, daylightOffset_sec, ntpServer);
  getLocalTime();

  // Initialize OLED display with I2C address 0x3C.
  if (!oled.begin(SSD1306_SWITCHCAPVCC, 0x3C)) {
    Serial.println(F("failed to start SSD1306 OLED"));
    while (1);
  }

  delay(2000);                 // wait two seconds for initializing
  oled.clearDisplay();         // clear display
  oled.setTextSize(1);         // set text size
  oled.setTextColor(WHITE);    // set text color
  oled.setCursor(0, 10);       // set position to display
  oled.display();              // display on OLED

  // Disconnect WiFi as it's no longer needed
  WiFi.disconnect(true);
  WiFi.mode(WIFI_OFF);
}

void loop() {
  // Do the BLE connection and sensor data receive first.
  if (doConnect == true) {
    if (connectToServer()) {
      Serial.println("We are now connected to the remote BLE Server.");
    } else {
      Serial.println("We have failed to connect to the remote server.");
    }
    doConnect = false;
  }
  
  // Once connected to the remote BLE Server, read sensor data.
  if (connected) {    
    // Read the value of the characteristic, the sensor data.
    if(pRemoteCharacteristic->canRead()) {
      std::string value = pRemoteCharacteristic->readValue();
      sensorData = convertToIntArray(value);
      Serial.print("The sensor value was: ");
      Serial.println(value.c_str());
    }
  } else if (doScan){
    BLEDevice::getScan()->start(0);  // scan after disconnect
  }
  
  oled.clearDisplay();
  oled.setCursor(0, 0); 

  struct tm lTime = getLocalTime();
  String date_time = String(lTime.tm_mday)+"/"+String(lTime.tm_mon)+" "+
                     String(lTime.tm_hour)+":"+String(lTime.tm_min)+":"+
                     String(lTime.tm_sec);

  // Display date and time in OLED
  oled.println(date_time);

  // Get individual sensor data.
  int R = get_colour();
  int T = get_temperature();
  int H = get_humidity();
  int P = get_pressure();
  int r = get_rain();
  int w = get_wind();
  int d = get_wind_direction();
  
  int t = lTime.tm_hour;
  if(t >= HOUR_SIX && t < HOUR_EIGHTEEN){
    oled.setCursor(85, 0); 
    oled.println("Daytime");
  }else {
    oled.setCursor(85, 0); 
    oled.println("Night");
  }

  oled.setCursor(0, 10);
  String R_str = "RGB - R    : "+String(R);
  oled.println(R_str);
  Serial.println(R_str);
  String T_str = "Temperature: "+String(T);
  oled.println(T_str + " " + (char)247 + "C");
  Serial.println(T_str + "°C");
  String H_str = "Humidity   : "+String(H);
  oled.println(H_str + " %");
  Serial.println(H_str + "%");
  String P_str = "Pressure   : "+String(P);
  oled.println(P_str + " kpl");
  Serial.println(P_str + "kpl");
  String r_str = "Rain       : "+String(r);
  oled.println(r_str +" %");
  Serial.println(r_str +"%");
  String w_str = "Wind       : "+String(w);
  oled.println(w_str +" kmh");
  Serial.println(w_str +" kmh");

  oled.display();
  delay(5000);
  oled.clearDisplay();
  oled.setCursor(0, 0);

  // Forecast the current weather. 
  String curr_forecast = forecast(T, t, R, r);
  oled.println(curr_forecast);
  Serial.print("current weather : ");
  Serial.println(curr_forecast);

  oled.setCursor(4, 14);
  bool iswind = false; 
  if(w >= WIND_MAX) {
    iswind = true;
    oled.println("Heavy Wind ->");
    Serial.println("Heavy Wind ->");
  }else if(w > WIND_MIN && w < WIND_MAX ){
    iswind = true;
    oled.println("Windy ->");
    Serial.println("Windy ->");    
  } else {
    iswind = false;
    oled.println("No Wind ->");
    Serial.println("No Wind ->");
  }

  oled.setCursor(4, 24);
  if(iswind) {
    if(d >= 900 && d < 100) {
      oled.println("South");
      Serial.println("South");    
    } else if(d >= 800 && d < 900) {
      oled.println("SouthEast");
      Serial.println("SouthEast");    
    } else if(d >= 650 && d < 800) {
      oled.println("East");
      Serial.println("East");    
    } else if(d >= 550 && d < 650) {
      oled.println("NorthEast");
      Serial.println("NorthEast");    
    } else if(d >= 450 && d < 550) {
      oled.println("North");
      Serial.println("North");    
    } else if(d >= 350 && d < 450) {
      oled.println("NorthWest");
      Serial.println("NorthWest");    
    }else if(d >= 200 && d < 350){
      oled.println("West");
      Serial.println("West");    
    } else {
      oled.println("SouthWest");
      Serial.println("SouthWest");    
    }
  }

  // Draw weather icon.
  int icon_width  = 57;
  int icon_height = 54;
  oled.drawBitmap(70, 7, weather_icon[weather_icon_index], icon_width, icon_height, BLACK, WHITE);

  // Forecast next 1 hour weather.
  if(previousMillis == 0) {
    previousMillis = 1;
    update_forecast_values(T, R, r);
    R_average_value = R_average();
    r_average_value = r_average();
    T_average_value = T_average();
  }
  long currentMillis = millis();
  // if 60000ms/1Min have passed, check the sensor level:
  if (currentMillis - previousMillis >= 60000) {
        previousMillis = currentMillis;
        update_forecast_values(T, R, r);
        R_average_value = R_average();
        r_average_value = r_average();
        T_average_value = T_average();
  }
  String one_hour_forecast = forecast(t+1, T_average_value, R_average_value, r_average_value);
  oled.setCursor(0, 40);
  oled.println("In 1 hour:");
  oled.setCursor(0, 52);
  oled.println(one_hour_forecast);
  Serial.print("In 1 hour: ");
  Serial.println(one_hour_forecast);

  oled.display();
  delay(5000);
}
